/**
 * @cliArgs --board "/ti/boards/CC3220S_LAUNCHXL" --product "simplelink_cc32xx_sdk@5.20.00.06"
 * @versions {"data":"2021031521","timestamp":"2021031521","tool":"1.8.0+1863","templates":null}
 */

/**
 * Import the modules used in this configuration.
 */
const Display        = scripting.addModule("/ti/display/Display", {}, false);
const Display1       = Display.addInstance();
const Crypto         = scripting.addModule("/ti/drivers/Crypto", {}, false);
const Crypto1        = Crypto.addInstance();
const GPIO           = scripting.addModule("/ti/drivers/GPIO");
const GPIO1          = GPIO.addInstance();
const GPIO2          = GPIO.addInstance();
const GPIO3          = GPIO.addInstance();
const GPIO4          = GPIO.addInstance();
const GPIO5          = GPIO.addInstance();
const GPIO6          = GPIO.addInstance();
const GPIO7          = GPIO.addInstance();
const GPIO8          = GPIO.addInstance();
const GPIO9          = GPIO.addInstance();
const GPIO10         = GPIO.addInstance();
const GPIO11         = GPIO.addInstance();
const GPIO12         = GPIO.addInstance();
const GPIO13         = GPIO.addInstance();
const RTOS           = scripting.addModule("/ti/drivers/RTOS");
const SPI            = scripting.addModule("/ti/drivers/SPI");
const SPI1           = SPI.addInstance();
const Timer          = scripting.addModule("/ti/drivers/Timer", {}, false);
const Timer1         = Timer.addInstance();
const Timer2         = Timer.addInstance();
const Timer3         = Timer.addInstance();
const Watchdog       = scripting.addModule("/ti/drivers/Watchdog", {}, false);
const Watchdog1      = Watchdog.addInstance();
const SimpleLinkWifi = scripting.addModule("/ti/drivers/net/wifi/SimpleLinkWifi");
const atcmd          = scripting.addModule("/ti/drivers/net/wifi/atcmd", {}, false);
const atcmd1         = atcmd.addInstance();
const net_utils      = scripting.addModule("/ti/drivers/net/wifi/net_utils", {}, false);
const net_utils1     = net_utils.addInstance();
const HTTPClient     = scripting.addModule("/ti/net/HTTPClient", {}, false);
const HTTPClient1    = HTTPClient.addInstance();
const MQTT           = scripting.addModule("/ti/net/MQTT", {}, false);
const MQTT1          = MQTT.addInstance();
const SNTP           = scripting.addModule("/ti/net/SNTP");
const SlNet          = scripting.addModule("/ti/net/SlNet", {}, false);
const SlNet1         = SlNet.addInstance();
const JSON           = scripting.addModule("/ti/utils/JSON");

/**
 * Write custom configuration values to the imported modules.
 */
Display1.$name                          = "CONFIG_Display_0";
Display1.$hardware                      = system.deviceData.board.components.XDS110UART;
Display1.uart.$name                     = "CONFIG_UART_0";
Display1.uart.useDMA                    = true;
Display1.uart.uart.$assign              = "UART0";
Display1.uart.uart.txPin.$assign        = "55";
Display1.uart.uart.rxPin.$assign        = "57";
Display1.uart.uart.txDmaChannel.$assign = "UDMA_CH9";
Display1.uart.uart.rxDmaChannel.$assign = "UDMA_CH8";

Crypto1.$name = "CONFIG_Crypto_0";

GPIO1.$name           = "LED1";
GPIO1.mode            = "Output";
GPIO1.outputStrength  = "High";
GPIO1.gpioPin.$assign = "boosterpack.4";

GPIO2.$name           = "LED2";
GPIO2.mode            = "Output";
GPIO2.outputStrength  = "High";
GPIO2.gpioPin.$assign = "boosterpack.7";

GPIO3.$name           = "LED3";
GPIO3.mode            = "Output";
GPIO3.outputStrength  = "High";
GPIO3.gpioPin.$assign = "boosterpack.14";

GPIO4.$name           = "LED4";
GPIO4.mode            = "Output";
GPIO4.outputStrength  = "High";
GPIO4.gpioPin.$assign = "boosterpack.15";

GPIO5.$name           = "LED5";
GPIO5.mode            = "Output";
GPIO5.outputStrength  = "High";
GPIO5.gpioPin.$assign = "boosterpack.18";

GPIO6.mode            = "Output";
GPIO6.$name           = "LED6";
GPIO6.outputStrength  = "High";
GPIO6.gpioPin.$assign = "boosterpack.19";

GPIO7.$name           = "AlarmButton";
GPIO7.pull            = "Pull Up";
GPIO7.gpioPin.$assign = "boosterpack.11";

GPIO8.$name           = "LaserButton";
GPIO8.pull            = "Pull Up";
GPIO8.gpioPin.$assign = "boosterpack.5";

GPIO9.$name           = "LaserDiode";
GPIO9.mode            = "Output";
GPIO9.outputStrength  = "High";
GPIO9.gpioPin.$assign = "boosterpack.30";

GPIO10.pull            = "Pull Up";
GPIO10.$name           = "SDA2";
GPIO10.gpioPin.$assign = "boosterpack.27";

GPIO11.pull                          = "Pull Up";
GPIO11.$name                         = "SCL2";
GPIO11.gpioPin.$assignAllowConflicts = "boosterpack.28";

GPIO12.$name           = "Alarm";
GPIO12.mode            = "Output";
GPIO12.outputStrength  = "High";
GPIO12.gpioPin.$assign = "boosterpack.8";

GPIO13.pull            = "Pull Up";
GPIO13.$name           = "IR_EN";
GPIO13.mode            = "Output";
GPIO13.gpioPin.$assign = "boosterpack.29";

const Power          = scripting.addModule("/ti/drivers/Power", {}, false);
Power.parkPins.$name = "ti_drivers_power_PowerCC32XXPins0";

SPI1.$name                             = "CONFIG_SPI_0";
SPI1.spi.$assign                       = "SPI0";
SPI1.spi.sclkPin.$assign               = "boosterpack.17";
SPI1.spi.misoPin.$assignAllowConflicts = "boosterpack.28";
SPI1.spi.mosiPin.$assign               = "52";

Timer1.timerType         = "32 Bits";
Timer1.interruptPriority = "2";
Timer1.$name             = "DebounceTimer";
Timer1.timer.$assign     = "Timer0";

Timer2.$name             = "AlarmTimer";
Timer2.timerType         = "32 Bits";
Timer2.interruptPriority = "1";
Timer2.timer.$assign     = "Timer1";

Timer3.$name             = "ButtonDebounceConifg";
Timer3.interruptPriority = "1";
Timer3.timerType         = "32 Bits";
Timer3.timer.$assign     = "Timer2";

Watchdog1.$name            = "CONFIG_WATCHDOG_0";
Watchdog1.watchdog.$assign = "WATCHDOG0";

atcmd1.$name = "CONFIG_ATCMD_0";

net_utils1.$name = "CONFIG_NET_UTILS_0";

HTTPClient1.$name = "CONFIG_HTTPCLIENT_0";

MQTT1.$name = "CONFIG_MQTT_0";

SlNet1.$name  = "CONFIG_SLNET_0";
SlNet1.ifName = "CC32xx";

/**
 * Pinmux solution for unlocked pins/peripherals. This ensures that minor changes to the automatic solver in a future
 * version of the tool will not impact the pinmux you originally saw.  These lines can be completely deleted in order to
 * re-solve from scratch.
 */
SPI1.spi.dmaRxChannel.$suggestSolution = "UDMA_CH30";
SPI1.spi.dmaTxChannel.$suggestSolution = "UDMA_CH31";
