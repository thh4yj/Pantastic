/**
 * These arguments were used when this file was generated. They will be automatically applied on subsequent loads
 * via the GUI or CLI. Run CLI with '--help' for additional information on how to override these arguments.
 * @cliArgs --board "/ti/boards/CC3220S_LAUNCHXL" --product "simplelink_cc32xx_sdk@5.20.00.06"
 * @versions {"data":"2021031521","timestamp":"2021031521","tool":"1.8.0+1863","templates":null}
 */

/**
 * Import the modules used in this configuration.
 */
const GPIO   = scripting.addModule("/ti/drivers/GPIO");
const GPIO1  = GPIO.addInstance();
const GPIO2  = GPIO.addInstance();
const GPIO3  = GPIO.addInstance();
const GPIO4  = GPIO.addInstance();
const GPIO5  = GPIO.addInstance();
const GPIO6  = GPIO.addInstance();
const GPIO7  = GPIO.addInstance();
const GPIO8  = GPIO.addInstance();
const GPIO9  = GPIO.addInstance();
const GPIO10 = GPIO.addInstance();
const GPIO11 = GPIO.addInstance();
const GPIO12 = GPIO.addInstance();
const GPIO13 = GPIO.addInstance();
const RTOS   = scripting.addModule("/ti/drivers/RTOS");
const Timer  = scripting.addModule("/ti/drivers/Timer", {}, false);
const Timer1 = Timer.addInstance();
const Timer2 = Timer.addInstance();

/**
 * Write custom configuration values to the imported modules.
 */
GPIO1.$name          = "LED1";
GPIO1.mode           = "Output";
GPIO1.outputStrength = "High";

GPIO2.$name          = "LED2";
GPIO2.mode           = "Output";
GPIO2.outputStrength = "High";

GPIO3.$name          = "LED3";
GPIO3.mode           = "Output";
GPIO3.outputStrength = "High";

GPIO4.$name          = "LED4";
GPIO4.mode           = "Output";
GPIO4.outputStrength = "High";

GPIO5.$name          = "LED5";
GPIO5.mode           = "Output";
GPIO5.outputStrength = "High";

GPIO6.mode           = "Output";
GPIO6.$name          = "LED6";
GPIO6.outputStrength = "High";

GPIO7.$name            = "AlarmButton";
GPIO7.callbackFunction = "HandleAlarmPush";
GPIO7.interruptTrigger = "Falling Edge";

GPIO8.$name            = "LaserButton";
GPIO8.interruptTrigger = "Falling Edge";
GPIO8.callbackFunction = "HandleLaserButton";

GPIO9.$name          = "LaserDiode";
GPIO9.mode           = "Output";
GPIO9.outputStrength = "High";

GPIO10.pull            = "Pull Up";
GPIO10.$name           = "SDA2";
GPIO10.gpioPin.$assign = "boosterpack.27";

GPIO11.pull  = "Pull Up";
GPIO11.$name = "SCL2";

GPIO12.$name           = "Alarm";
GPIO12.mode            = "Output";
GPIO12.outputStrength  = "High";
GPIO12.gpioPin.$assign = "boosterpack.8";

GPIO13.$name = "Alarm2";
GPIO13.mode  = "Output";
GPIO13.pull  = "Pull Down";

const Power          = scripting.addModule("/ti/drivers/Power", {}, false);
Power.parkPins.$name = "ti_drivers_power_PowerCC32XXPins0";

Timer1.timerType         = "32 Bits";
Timer1.interruptPriority = "2";
Timer1.$name             = "DebounceTimer";
Timer1.timer.$assign     = "Timer0";

Timer2.$name             = "AlarmTimer";
Timer2.timerType         = "32 Bits";
Timer2.interruptPriority = "2";
Timer2.timer.$assign     = "Timer1";

/**
 * Pinmux solution for unlocked pins/peripherals. This ensures that minor changes to the automatic solver in a future
 * version of the tool will not impact the pinmux you originally saw.  These lines can be completely deleted in order to
 * re-solve from scratch.
 */
GPIO1.gpioPin.$suggestSolution  = "boosterpack.4";
GPIO2.gpioPin.$suggestSolution  = "boosterpack.7";
GPIO3.gpioPin.$suggestSolution  = "boosterpack.14";
GPIO4.gpioPin.$suggestSolution  = "boosterpack.15";
GPIO5.gpioPin.$suggestSolution  = "boosterpack.18";
GPIO6.gpioPin.$suggestSolution  = "boosterpack.19";
GPIO7.gpioPin.$suggestSolution  = "boosterpack.13";
GPIO8.gpioPin.$suggestSolution  = "boosterpack.17";
GPIO9.gpioPin.$suggestSolution  = "boosterpack.30";
GPIO11.gpioPin.$suggestSolution = "boosterpack.28";
GPIO13.gpioPin.$suggestSolution = "boosterpack.5";
